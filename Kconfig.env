## Kconfig.env
```kconfig
menu "Project root directory, compiler"

config PRJROOT
  string "Project root directory"
  default "C:/Projects/silabs_bluetooth"
  
config CROSS_CC
  string "Cross compiler"
  default "arm-none-eabi-gcc.exe"
  
config CROSS_LD
  string "Cross linker"
  default "arm-none-eabi-ld.exe"
  
config CROSS_OBJCPY
  string "Cross compiler"
  default "arm-none-eabi-objcpy.exe"
  
config CROSS_DUMP
  string "Cross compiler"
  default "arm-none-eabi-objdump.exe"

config MAKE
  string "GNU Make"
  default "make.exe"
  
endmenu
```

## applications/Kconfig
```kconfig
choice
  prompt "Choose your application"
  default APP_LED

# Non BLE Examples
source "applications/led/Kconfig.app"
source "applications/cpuid/Kconfig.app"
source "applications/sin_cos_dsp/Kconfig.app"

# BLE Examples
source "applications/ble_adv/Kconfig.app"
source "applications/ble_hci/Kconfig.app"
source "applications/ble_throughput/Kconfig.app"
source "applications/prs_radio/Kconfig.app"

endchoice
```

## applications/accelerometer/Kconfig.app
```kconfig
config APP_ACCELEROMETER_BMA440
	bool "BMA 440 accelerometer example over I2C"
  depends on BOARD_EFR32BGM220_EXP_KIT
	
```

## applications/mesh/Kconfig
```kconfig
config APP_MESH
  bool "Bluetooth Mesh"
  depends on BOARD_EFR32MG21_BRD4181A01
  
if APP_MESH
  choice
    prompt "Choose your Bluetooth Mesh application"
  
    source "applications/mesh/embedded_provisioner/Kconfig.app"
    source "applications/mesh/subnet_bridge/Kconfig.app"
    source "applications/mesh/edge_node/Kconfig.app"
  
  endchoice
endif
```

## applications/mesh/edge_node/Kconfig.app
```kconfig
config APP_MESH_EDGE_NODE
  bool "Bluetooth Mesh edge node (light/switch/sensor whatever)"
	select BLUETOOTH_MESH
```

## applications/mesh/embedded_provisioner/Kconfig.app
```kconfig
config APP_MESH_EMBEDDED_PROVISIONER
  bool "Bluetooth Mesh Embedded Provisioner"
	select BLUETOOTH_MESH
```

## applications/mesh/subnet_bridge/Kconfig.app
```kconfig
config APP_MESH_SUBNET_BRIDGE
  bool "Bluetooth Mesh Node/Provisioner bridge"
	select BLUETOOTH_MESH
```

## boards/Kconfig
```kconfig
choice
	prompt "Choose your board"
	default BOARD_EFR32BG22_SLTB010A

source "../boards/bgm220_explorer_kit/Kconfig.board"
source "../boards/thunderboard_bg22/Kconfig.board"

endchoice
```

## boards/bgm220_explorer_kit/Kconfig.board
```kconfig
# Eplorer kit board

config BOARD_EFR32BGM220_EXP_KIT
	bool "SiLabs BGM220 Explorer kit"
	select SOC_PART_NUMBER_BGM220PC22HNA

if BOARD_EFR32BGM220_EXP_KIT
choice
  prompt "Choose the BMA400 acceleromer bus"

  config APP_BMA400_I2C0
    bool "BMA400 on I2C0 bus"
  
  config APP_BMA400_SPI0
    bool "BMA400 on SPI0 bus"
endchoice
endif
	
	
	
```

## boards/brd4181a01/Kconfig.board
```kconfig
# EFR32MG21 BRD4181A01 board

config BOARD_EFR32MG21_BRD4181A01
	bool "SiLabs EFR32MG21-BRD4181A01 (EFR32xG21 Wireless Gecko Starter Kit)"
	select SOC_PART_NUMBER_EFR32MG21A020F1024IM32
	
```

## boards/thunderboard_bg22/Kconfig.board
```kconfig
# EFR32BG SLTB010A board

config BOARD_EFR32BG22_SLTB010A
	bool "SiLabs EFR32BG22-SLTB010A (Thunderboard Sense BG22)"
	depends on SOC_SERIES_EFR32BG22
	select SOC_PART_NUMBER_EFR32BG22C224F512IM40
```

## boards/thunderboard_s2/Kconfig.board
```kconfig
# EFR32MG12 SLTB004A board

config BOARD_EFR32MG12P_SLTB004A
	bool "SiLabs EFR32MG12P SLTB004A (Thunderboard Sense 2)"
	select SOC_PART_NUMBER_EFR32MG12P332F1024GL125
	
```

## soc/Kconfig
```kconfig
choice
	prompt "Choose your chip"
	default SOC_SERIES_EFR32BG22

source "soc/bgm220/Kconfig.series"
source "soc/efr32bg22/Kconfig.series"
source "soc/efr32bg21/Kconfig.series"

endchoice
```

## soc/bgm220/Kconfig.series
```kconfig
# Silicon Labs BGM220 Module
# Copyright (c) 2020 Silicon Labs

config SOC_SERIES_EFR32BGM220
	bool "BGM220P Series MCU"
	depends on BOARD_EFR32BGM220_EXP_KIT
	select ARM
	select CPU_CORTEX_M33
	select CPU_CORTEX_M_HAS_DWT
	select ARMV8_M_DSP
	select CPU_HAS_FPU
	select CPU_HAS_ARM_MPU
  select CPU_HAS_ARM_DSP
	select SOC_FAMILY_EXX32
	select HAS_SILABS_GECKO
	select HAS_SWO
	select HAS_POWER_STATE_SLEEP_1
	select HAS_POWER_STATE_SLEEP_2
	select HAS_POWER_STATE_SLEEP_3
	select SOC_GECKO_CORE
	select SOC_GECKO_CMU
	select SOC_GECKO_EMU
	select SOC_GECKO_GPIO
	select SOC_GECKO_SE
	help
	  Enable support for BGM220 Modules
```

## soc/efr32bg21/Kconfig.series
```kconfig
# Silicon Labs EFR32BG21 (Blue Gecko) MCU

# Copyright (c) 2020 Silicon Labs

config SOC_SERIES_EFR32BG21
	bool "EFR32BG21 Series MCU"
	depends on BOARD_EFR32BG21_BRD4181A01
	select ARM
	select CPU_CORTEX_M33
	select CPU_CORTEX_M_HAS_DWT
	select ARMV8_M_DSP
	select CPU_HAS_FPU
	select CPU_HAS_ARM_MPU
	select SOC_FAMILY_EXX32
	select HAS_SILABS_GECKO
	select HAS_SWO
	select HAS_POWER_STATE_SLEEP_1
	select HAS_POWER_STATE_SLEEP_2
	select HAS_POWER_STATE_SLEEP_3
	select SOC_GECKO_CORE
	select SOC_GECKO_CMU
	select SOC_GECKO_EMU
	select SOC_GECKO_GPIO
	select SOC_GECKO_SE
	help
	  Enable support for EFR32BG21 Blue Gecko MCU series
```

## target/Kconfig
```kconfig
mainmenu "Silicon Labs Bluetooth"

# General configuration options

source "Kconfig.env"
source "../boards/Kconfig"
source "../soc/Kconfig"
source "applications/Kconfig"
```

## target/applications/Kconfig
```kconfig
choice
  prompt "Choose your application"
  default APP_LED

source "target/applications/led/Kconfig.app"
source "target/applications/ble_adv/Kconfig.app"

endchoice
```
